## sdkconfig.defaults
```kconfig
# ESP32-S3FH4R2 构建基线配置（C-04：sdkconfig.defaults 入库，sdkconfig 不入库）
CONFIG_IDF_TARGET="esp32s3"

# Flash / PSRAM（FH4R2：4MB flash + 2MB PSRAM，四线模式）
CONFIG_ESPTOOLPY_FLASHSIZE_4MB=y
CONFIG_SPIRAM=y
CONFIG_SPIRAM_MODE_QUAD=y
# 注意：禁止 CONFIG_SPIRAM_MODE_OCT（会占用 GPIO33~37 与 SD 冲突，README §3.3-2）

# 分区：单 App 大分区（预留 ≥30% 余量）
CONFIG_PARTITION_TABLE_SINGLE_APP_LARGE=y

# 控制台：UART0 主调试口 + USB-Serial-JTAG 副口（USB-CDC 升级+串口）
CONFIG_ESP_CONSOLE_UART_DEFAULT=y
CONFIG_ESP_CONSOLE_SECONDARY_USB_SERIAL_JTAG=y

# 日志级别
CONFIG_LOG_DEFAULT_LEVEL_INFO=y

# 任务看门狗（默认开启；传感器任务周期轮询可喂）
CONFIG_ESP_TASK_WDT_TIMEOUT_S=10

# ===== LVGL 9（阶段 2） =====
CONFIG_LV_COLOR_DEPTH_16=y
CONFIG_LV_MEM_SIZE_KILOBYTES=64
CONFIG_LV_DISP_DEF_REFR_PERIOD=30
CONFIG_LV_USE_STDLIB_SPRINTF=y   # 关键：LVGL 自研 sprintf 不支持 %f → 切标准库（否则 UI 显示 f 而非数字）
CONFIG_LV_BUILD_EXAMPLES=n   # 禁用官方示例编译（依赖已关 widget，且省 Flash）
# 字体只保留实际用到的（状态栏12/数据16/计时24/大数字48 + 默认14）；每个字体 10~60KB
CONFIG_LV_FONT_MONTSERRAT_12=y
CONFIG_LV_FONT_MONTSERRAT_14=y
CONFIG_LV_FONT_MONTSERRAT_16=y
CONFIG_LV_FONT_MONTSERRAT_24=y
CONFIG_LV_FONT_MONTSERRAT_48=y
CONFIG_LV_USE_LABEL=y
CONFIG_LV_USE_LINE=y
CONFIG_LV_USE_ARC=y
CONFIG_LV_USE_BAR=y
CONFIG_LV_USE_IMG=y
# 未用 widget 全部关闭（LVGL 9 默认全开，每个 1~8KB，合计 ~100KB）
CONFIG_LV_USE_CHART=n
CONFIG_LV_USE_TABLE=n
CONFIG_LV_USE_CALENDAR=n
CONFIG_LV_USE_METER=n
CONFIG_LV_USE_MSGBOX=n
CONFIG_LV_USE_TEXTAREA=n
CONFIG_LV_USE_CANVAS=n
CONFIG_LV_USE_DROPDOWN=n
CONFIG_LV_USE_ROLLER=n
CONFIG_LV_USE_SLIDER=n
CONFIG_LV_USE_SWITCH=n
CONFIG_LV_USE_CHECKBOX=n
CONFIG_LV_USE_RADIO=n
CONFIG_LV_USE_LIST=n
CONFIG_LV_USE_MENU=n
CONFIG_LV_USE_TABVIEW=n
CONFIG_LV_USE_TILEVIEW=n
CONFIG_LV_USE_WIN=n
CONFIG_LV_USE_KEYBOARD=n
CONFIG_LV_USE_SPINBOX=n
CONFIG_LV_USE_SPAN=n
CONFIG_LV_USE_ANIMIMG=n
CONFIG_LV_USE_LED=n
CONFIG_LV_USE_LMETER=n
CONFIG_LV_USE_GAUGE=n
CONFIG_LV_USE_BTNMATRIX=n
CONFIG_LV_USE_SPINNER=n
```
